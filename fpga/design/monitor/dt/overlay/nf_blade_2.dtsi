/dts-v1/;
/plugin/;

/ {
	fragment@0 {
		target-path = "/amba_pl@0/i2c@a0002000/i2c-mux@74";
		__overlay__ {
			i2c@5 {
                                #address-cells = <1>;
                                #size-cells = <0>;
                                reg = <5>;
			};
		};
	};
};
